## stack-chan/main/Kconfig.projbuild
```kconfig
menu "Xiaopai settings"

    config STACKCHAN_WIFI_SSID
        string "Wi-Fi SSID"
        default "MYENDLESS"

    config STACKCHAN_WIFI_PASSWORD
        string "Wi-Fi password"
        default "88888888"

    config STACKCHAN_OTA_URL
        string "OTA URL"
        default "http://192.168.137.1:8091/ota"

    config STACKCHAN_FIRMWARE_OTA_ENABLED
        bool "Enable Xiaopai firmware OTA"
        default y

    config STACKCHAN_FIRMWARE_OTA_TIMEOUT_MS
        int "Firmware OTA HTTP timeout milliseconds"
        default 60000
        range 5000 300000

    config STACKCHAN_RECORD_UPLOAD_URL
        string "Record upload URL"
        default "http://<server-ip>:8091/upload-audio"

    config STACKCHAN_STREAM_TTS_URL
        string "Stream TTS URL"
        default "http://192.168.21.15:8091/stream-speak"

    config STACKCHAN_TTS_URL
        string "TTS URL"
        default "http://192.168.21.15:8091/speak?text="

    config STACKCHAN_TTS_TEXT
        string "TTS text"
        default "Hello, I am Xiaopai"

    config STACKCHAN_TTS_VOLUME
        int "TTS volume"
        default 13
        range 0 255

    config STACKCHAN_TTS_MAX_BYTES
        int "TTS max bytes"
        default 2097152

    config STACKCHAN_RECORD_SAMPLE_RATE
        int "Record sample rate"
        default 16000

    config STACKCHAN_AUDIO_FULL_DUPLEX
        bool "Enable full-duplex CoreS3 audio service"
        default y

    config STACKCHAN_AUDIO_TX_ENABLED
        bool "Enable CoreS3 speaker I2S TX"
        default y
        help
            Disable this for microphone-only diagnostics. When disabled, the
            AW88298 speaker output and I2S TX channel are not initialized.

    config STACKCHAN_AUDIO_DEVICE_AEC
        bool "Enable device-side AEC with ESP-SR AFE"
        default n

    config STACKCHAN_AUDIO_HW_SAMPLE_RATE
        int "Hardware codec sample rate"
        default 24000
        range 16000 48000

    config STACKCHAN_AUDIO_UPSTREAM_SAMPLE_RATE
        int "Microphone/ASR upstream sample rate"
        default 16000
        range 8000 48000

    config STACKCHAN_AUDIO_DOWNSTREAM_SAMPLE_RATE
        int "TTS/playback downstream sample rate"
        default 24000
        range 8000 48000

    config STACKCHAN_AUDIO_INPUT_REFERENCE
        bool "Use ES7210 reference input"
        default n

    config STACKCHAN_AUDIO_INPUT_GAIN
        int "ES7210 microphone input gain"
        default 60
        range 0 100

    config STACKCHAN_AUDIO_OUTPUT_VOLUME_DEFAULT
        int "Default output volume percent"
        default 10
        range 0 100

    config STACKCHAN_RECORD_CHUNK_MS
        int "Record chunk milliseconds"
        default 40

    config STACKCHAN_PREROLL_MS
        int "Pre-roll milliseconds"
        default 800

    config STACKCHAN_VOICE_START_THRESHOLD
        int "Voice start threshold"
        default 1500

    config STACKCHAN_VOICE_STOP_THRESHOLD
        int "Voice stop threshold"
        default 800

    config STACKCHAN_MIC_MAGNIFICATION
        int "Microphone magnification"
        default 1

    config STACKCHAN_DJI_MIC_USB_INPUT
        bool "Enable DJI Mic receiver USB input"
        default y

    config STACKCHAN_DJI_MIC_AUTO_START
        bool "Auto start DJI Mic USB input on boot"
        depends on STACKCHAN_DJI_MIC_USB_INPUT
        default n
        help
            Delayed boot start only. Audio init must not open USB Host. If a PC
            USB Serial/JTAG host is detected, auto-start is skipped. Use
            dji_mic_start after unplugging the PC and attaching the receiver.

    config STACKCHAN_DJI_MIC_DRIVE_VBUS
        bool "Drive CoreS3 USB VBUS for DJI Mic"
        depends on STACKCHAN_DJI_MIC_USB_INPUT
        default y

    config STACKCHAN_DJI_MIC_STABLE_MS
        int "Continuous DJI PCM required before source switch"
        depends on STACKCHAN_DJI_MIC_USB_INPUT
        default 800
        range 100 5000

    config STACKCHAN_DJI_MIC_VBUS_OFF_MS
        int "DJI VBUS off time before USB host start"
        depends on STACKCHAN_DJI_MIC_DRIVE_VBUS
        default 800
        range 100 5000

    config STACKCHAN_DJI_MIC_HOST_LISTEN_MS
        int "USB host listen time before enabling VBUS"
        depends on STACKCHAN_DJI_MIC_DRIVE_VBUS
        default 400
        range 0 2000

    config STACKCHAN_DJI_MIC_VBUS_SETTLE_MS
        int "DJI VBUS settle time after enable"
        depends on STACKCHAN_DJI_MIC_DRIVE_VBUS
        default 2000
        range 100 5000

    choice STACKCHAN_DJI_MIC_CHANNEL_MODE
        prompt "DJI Mic channel selection"
        depends on STACKCHAN_DJI_MIC_USB_INPUT
        default STACKCHAN_DJI_MIC_CHANNEL_AUTO_ONCE

        config STACKCHAN_DJI_MIC_CHANNEL_LEFT
            bool "Left"

        config STACKCHAN_DJI_MIC_CHANNEL_RIGHT
            bool "Right"

        config STACKCHAN_DJI_MIC_CHANNEL_MIX
            bool "Mix left and right"

        config STACKCHAN_DJI_MIC_CHANNEL_AUTO_ONCE
            bool "Choose strongest channel once per connection"
    endchoice

    config STACKCHAN_DJI_MIC_DIGITAL_GAIN_PERCENT
        int "DJI Mic digital gain percent"
        depends on STACKCHAN_DJI_MIC_USB_INPUT
        default 100
        range 25 400

    config STACKCHAN_DJI_VOICE_START_THRESHOLD
        int "DJI Mic voice start threshold"
        depends on STACKCHAN_DJI_MIC_USB_INPUT
        default 900
        range 50 20000

    config STACKCHAN_DJI_VOICE_STOP_THRESHOLD
        int "DJI Mic voice stop threshold"
        depends on STACKCHAN_DJI_MIC_USB_INPUT
        default 400
        range 25 10000

    config STACKCHAN_DJI_MIC_START_DELAY_MS
        int "Delay before starting DJI Mic USB input after boot"
        depends on STACKCHAN_DJI_MIC_USB_INPUT
        default 10000
        range 0 30000

    config STACKCHAN_DJI_MIC_MAX_START_RETRIES
        int "Maximum DJI USB host start attempts"
        depends on STACKCHAN_DJI_MIC_USB_INPUT
        default 3
        range 1 10

    config STACKCHAN_DJI_MIC_RETRY_BACKOFF_MS
        int "DJI USB host retry backoff"
        depends on STACKCHAN_DJI_MIC_USB_INPUT
        default 2000
        range 250 30000

    config STACKCHAN_DJI_MIC_ENUM_ONLY
        bool "Run only DJI Mic USB descriptor enumeration"
        depends on STACKCHAN_DJI_MIC_USB_INPUT
        default n

    config STACKCHAN_DJI_MIC_UAC_RECORD
        bool "Upload DJI Mic UAC microphone stream as WAV over Wi-Fi"
        depends on STACKCHAN_DJI_MIC_USB_INPUT && !STACKCHAN_DJI_MIC_ENUM_ONLY && !STACKCHAN_DJI_MIC_AUTO_START
        default n

    config STACKCHAN_DJI_MIC_UAC_RECORD_RATE
        int "DJI Mic UAC record sample rate"
        depends on STACKCHAN_DJI_MIC_USB_INPUT
        default 48000
        range 8000 48000

    config STACKCHAN_DJI_MIC_UAC_RECORD_CHANNELS
        int "DJI Mic UAC record channels"
        depends on STACKCHAN_DJI_MIC_USB_INPUT
        default 2
        range 1 2

    config STACKCHAN_DJI_MIC_UAC_RECORD_BITS
        int "DJI Mic UAC record bit resolution"
        depends on STACKCHAN_DJI_MIC_USB_INPUT
        default 24
        range 8 24

    config STACKCHAN_DJI_MIC_UAC_RECORD_SECONDS
        int "DJI Mic UAC record duration seconds"
        depends on STACKCHAN_DJI_MIC_UAC_RECORD
        default 5
        range 1 300

    config STACKCHAN_DJI_MIC_UAC_RINGBUF_BYTES
        int "DJI Mic UAC callback ringbuffer bytes"
        depends on STACKCHAN_DJI_MIC_USB_INPUT
        default 65536
        range 8192 524288

    config STACKCHAN_DJI_MIC_UAC_INTERNAL_BUF_BYTES
        int "usb_stream internal mic buffer bytes"
        depends on STACKCHAN_DJI_MIC_USB_INPUT
        default 16384
        range 0 262144

    config STACKCHAN_DJI_MIC_USB_ASSUME_RATE
        int "Fallback USB microphone sample rate"
        default 48000
        range 16000 96000

    config STACKCHAN_DJI_MIC_USB_ASSUME_CHANNELS
        int "Fallback USB microphone channels"
        default 2
        range 1 2

    config STACKCHAN_NETWORK_DEBUG
        bool "Enable permanent Wi-Fi command and log debugging"
        default y
        help
            Receive commands through the normal device command channel and mirror
            ESP-IDF logs to the server /device/logs endpoint without using USB.

    config STACKCHAN_NETWORK_DEBUG_QUEUE_DEPTH
        int "Pending log lines waiting for immediate upload"
        depends on STACKCHAN_NETWORK_DEBUG
        default 64
        range 8 256
        help
            Transport queue only. Each captured line is posted to /device/logs
            immediately by a dedicated task. If Wi-Fi is down or the uploader
            is busy, extra lines are dropped instead of overwriting a ring.

    config STACKCHAN_NETWORK_DEBUG_BATCH_LINES
        int "Maximum log lines per upload"
        depends on STACKCHAN_NETWORK_DEBUG
        default 8
        range 1 20
        help
            Lines that arrive while an HTTP post is in flight are sent together
            on the next immediate upload.

    config STACKCHAN_DJI_MIC_LOW_BATTERY_PROTECTION
        bool "Stop DJI Mic and USB VBUS on low battery"
        depends on STACKCHAN_DJI_MIC_USB_INPUT
        default n
        help
            Enable this only when DJI Mic may run from the internal battery.
            Keep it disabled when an external supply is mandatory: transient
            battery-voltage dips will still be logged, but they will not stop
            DJI USB capture or disable VBUS. USB overcurrent safe mode remains
            active regardless of this setting.

    config STACKCHAN_BATTERY_DJI_START_PERCENT
        int "Minimum battery percent to start DJI USB"
        depends on STACKCHAN_DJI_MIC_LOW_BATTERY_PROTECTION
        default 30
        range 5 100

    config STACKCHAN_BATTERY_LOW_PERCENT
        int "Battery percent that triggers load shedding"
        default 15
        range 1 50

    config STACKCHAN_BATTERY_LOW_MV
        int "Battery voltage that triggers load shedding"
        default 3550
        range 3200 4000

    config STACKCHAN_BATTERY_CRITICAL_MV
        int "Battery voltage that triggers safe power-off"
        default 3400
        range 3000 3800

    config STACKCHAN_BATTERY_SAMPLE_MS
        int "Battery monitor sample interval"
        default 1000
        range 200 10000

    config STACKCHAN_BATTERY_DEBOUNCE_SAMPLES
        int "Consecutive low battery samples before action"
        default 5
        range 1 30

    config STACKCHAN_BATTERY_RECOVERY_HYSTERESIS_MV
        int "Battery recovery hysteresis"
        default 150
        range 50 400

    config STACKCHAN_BATTERY_EMERGENCY_POWEROFF
        bool "Shed load after persistent critical battery"
        default n
        help
            Do not call PMIC powerOff. A false low reading a few seconds after
            boot was causing an automatic restart loop.

    config STACKCHAN_RECORD_MAX_MS
        int "Record max milliseconds"
        default 15000

    config STACKCHAN_SILENCE_STOP_MS
        int "Silence stop milliseconds"
        default 2500

endmenu
```

## stack-chan/sdkconfig.defaults
```kconfig
CONFIG_IDF_TARGET="esp32s3"
CONFIG_ESPTOOLPY_FLASHMODE_QIO=y
CONFIG_ESPTOOLPY_FLASHSIZE_16MB=y
CONFIG_ESP_DEFAULT_CPU_FREQ_MHZ_240=y
CONFIG_SPIRAM=y
CONFIG_SPIRAM_SPEED_80M=y
CONFIG_COMPILER_CXX_EXCEPTIONS=y
CONFIG_COMPILER_CXX_RTTI=y
CONFIG_FREERTOS_HZ=1000
CONFIG_ESP_CONSOLE_USB_SERIAL_JTAG=y
CONFIG_ESP_CONSOLE_SECONDARY_NONE=y
# CONFIG_ESP_CONSOLE_SECONDARY_USB_SERIAL_JTAG is not set
CONFIG_STACKCHAN_WIFI_SSID="YOUR_WIFI_SSID"
CONFIG_STACKCHAN_WIFI_PASSWORD="YOUR_WIFI_PASSWORD"
CONFIG_STACKCHAN_OTA_URL="http://127.0.0.1:8091/ota"
CONFIG_STACKCHAN_FIRMWARE_OTA_ENABLED=y
CONFIG_STACKCHAN_FIRMWARE_OTA_TIMEOUT_MS=60000
CONFIG_STACKCHAN_RECORD_UPLOAD_URL="http://127.0.0.1:8091/upload-audio"
CONFIG_STACKCHAN_STREAM_TTS_URL="http://127.0.0.1:8091/stream-speak"
CONFIG_STACKCHAN_TTS_URL="http://127.0.0.1:8091/speak?text="
CONFIG_STACKCHAN_TTS_TEXT="Hello, I am Xiaopai"
CONFIG_STACKCHAN_TTS_VOLUME=13
CONFIG_STACKCHAN_TTS_MAX_BYTES=2097152
CONFIG_STACKCHAN_RECORD_SAMPLE_RATE=16000
CONFIG_STACKCHAN_AUDIO_FULL_DUPLEX=y
CONFIG_STACKCHAN_AUDIO_TX_ENABLED=y
# CONFIG_STACKCHAN_AUDIO_DEVICE_AEC is not set
CONFIG_STACKCHAN_AUDIO_HW_SAMPLE_RATE=24000
CONFIG_STACKCHAN_AUDIO_UPSTREAM_SAMPLE_RATE=16000
CONFIG_STACKCHAN_AUDIO_DOWNSTREAM_SAMPLE_RATE=24000
# CONFIG_STACKCHAN_AUDIO_INPUT_REFERENCE is not set
CONFIG_STACKCHAN_AUDIO_INPUT_GAIN=60
CONFIG_STACKCHAN_AUDIO_OUTPUT_VOLUME_DEFAULT=10
CONFIG_CODEC_ES7210_SUPPORT=y
CONFIG_CODEC_AW88298_SUPPORT=y
CONFIG_STACKCHAN_RECORD_CHUNK_MS=40
CONFIG_STACKCHAN_PREROLL_MS=800
CONFIG_STACKCHAN_VOICE_START_THRESHOLD=1500
CONFIG_STACKCHAN_VOICE_STOP_THRESHOLD=800
CONFIG_STACKCHAN_MIC_MAGNIFICATION=1
CONFIG_STACKCHAN_DJI_MIC_USB_INPUT=y
CONFIG_STACKCHAN_DJI_MIC_AUTO_START=y
CONFIG_STACKCHAN_DJI_MIC_DRIVE_VBUS=y
# CONFIG_STACKCHAN_DJI_MIC_LOW_BATTERY_PROTECTION is not set
CONFIG_STACKCHAN_DJI_MIC_START_DELAY_MS=10000
CONFIG_STACKCHAN_DJI_MIC_MAX_START_RETRIES=3
CONFIG_STACKCHAN_DJI_MIC_RETRY_BACKOFF_MS=2000
CONFIG_STACKCHAN_DJI_MIC_ENUM_ONLY=n
CONFIG_STACKCHAN_DJI_MIC_UAC_RECORD=n
CONFIG_STACKCHAN_DJI_MIC_STABLE_MS=800
CONFIG_STACKCHAN_DJI_MIC_VBUS_OFF_MS=800
CONFIG_STACKCHAN_DJI_MIC_HOST_LISTEN_MS=400
CONFIG_STACKCHAN_DJI_MIC_VBUS_SETTLE_MS=2000
CONFIG_STACKCHAN_DJI_MIC_CHANNEL_AUTO_ONCE=y
CONFIG_STACKCHAN_DJI_MIC_DIGITAL_GAIN_PERCENT=100
CONFIG_STACKCHAN_DJI_VOICE_START_THRESHOLD=900
CONFIG_STACKCHAN_DJI_VOICE_STOP_THRESHOLD=400
CONFIG_STACKCHAN_DJI_MIC_UAC_RECORD_RATE=48000
CONFIG_STACKCHAN_DJI_MIC_UAC_RECORD_CHANNELS=2
CONFIG_STACKCHAN_DJI_MIC_UAC_RECORD_BITS=24
CONFIG_STACKCHAN_DJI_MIC_UAC_RECORD_SECONDS=5
CONFIG_STACKCHAN_DJI_MIC_UAC_RINGBUF_BYTES=65536
CONFIG_STACKCHAN_DJI_MIC_UAC_INTERNAL_BUF_BYTES=16384
CONFIG_STACKCHAN_NETWORK_DEBUG=y
CONFIG_STACKCHAN_NETWORK_DEBUG_QUEUE_DEPTH=64
CONFIG_STACKCHAN_NETWORK_DEBUG_BATCH_LINES=8
# CONFIG_STACKCHAN_SERIAL_DEBUG_COMMAND is not set
# ESP_GDBSTUB_ENABLED is hidden and defaults to y in ESP-IDF 5.5. Keep both
# activation paths disabled and omit its optional task-list support.
# CONFIG_ESP_SYSTEM_GDBSTUB_RUNTIME is not set
CONFIG_ESP_SYSTEM_PANIC_PRINT_REBOOT=y
# CONFIG_ESP_GDBSTUB_SUPPORT_TASKS is not set
# CONFIG_ESP_DEBUG_OCDAWARE is not set
# CONFIG_FREERTOS_DEBUG_OCDAWARE is not set
CONFIG_STACKCHAN_BATTERY_DJI_START_PERCENT=30
CONFIG_STACKCHAN_BATTERY_LOW_PERCENT=15
CONFIG_STACKCHAN_BATTERY_LOW_MV=3550
CONFIG_STACKCHAN_BATTERY_CRITICAL_MV=3400
CONFIG_STACKCHAN_BATTERY_SAMPLE_MS=1000
CONFIG_STACKCHAN_BATTERY_DEBOUNCE_SAMPLES=5
CONFIG_STACKCHAN_BATTERY_RECOVERY_HYSTERESIS_MV=150
# CONFIG_STACKCHAN_BATTERY_EMERGENCY_POWEROFF is not set
CONFIG_USB_PROC_TASK_STACK_SIZE=8192
CONFIG_STACKCHAN_RECORD_MAX_MS=15000
CONFIG_STACKCHAN_SILENCE_STOP_MS=2500
CONFIG_PARTITION_TABLE_CUSTOM=y
CONFIG_PARTITION_TABLE_CUSTOM_FILENAME="partitions.csv"
CONFIG_PARTITION_TABLE_FILENAME="partitions.csv"
CONFIG_CAMERA_DMA_BUFFER_SIZE_MAX=32768
CONFIG_CAMERA_PSRAM_DMA=y
```
